## firmware/coordinator_module/sdkconfig.defaults
```kconfig
CONFIG_IDF_TARGET="esp32s3"
CONFIG_ESP_DEFAULT_CPU_FREQ_MHZ_240=y
CONFIG_ESPTOOLPY_FLASHMODE_QIO=y
CONFIG_ESPTOOLPY_FLASHFREQ_80M=y
CONFIG_ESPTOOLPY_FLASHSIZE_8MB=y
CONFIG_SPIRAM=y
CONFIG_SPIRAM_MODE_OCT=y
CONFIG_SPIRAM_XIP_FROM_PSRAM=y
CONFIG_SPIRAM_RODATA=y
CONFIG_SPIRAM_SPEED_80M=y
CONFIG_FREERTOS_HZ=1000
CONFIG_ESP32S3_INSTRUCTION_CACHE_32KB=y
CONFIG_ESP32S3_DATA_CACHE_64KB=y
CONFIG_ESP32S3_DATA_CACHE_LINE_64B=y
CONFIG_LV_COLOR_DEPTH_16=y
CONFIG_LV_FONT_MONTSERRAT_48=y
```

## firmware/coordinator_module/src/Kconfig.projbuild
```kconfig
menu "Wi-Fi"

config APP_WIFI_SSID
    string "Wi-Fi SSID"
    default ""
    help
        Leave blank to scan for nearby access points without connecting.

config APP_WIFI_PASSWORD
    string "Wi-Fi password"
    default ""
    help
        Password for the configured Wi-Fi network. Leave blank for an open network.

endmenu
```
